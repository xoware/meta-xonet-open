## conf/machine/xo1-mvs.conf
```bitbake
#@TYPE: Machine
#@Name: Cavium Econa platform 
#@DESCRIPTION: Machine configuration for Xo1  Econa based board

require conf/machine/include/tune-arm1136jf-s.inc

MACHINE_FEATURES = "kernel26"
#KERNEL_DEVICETREE = "${S}/arch/arm/boot/dts/sama5d31ek.dts"


PREFERRED_PROVIDER_virtual/kernel = "linux-yocto-custom"
PREFEFFED_PROVIDER_virtual/bootloader = "u-boot-xo1"
PREFEFFED_PROVIDER_u-boot = "u-boot-xo1"

VIRTUAL-RUNTIME_dev_manager = "busybox-mdev"
VIRTUAL-RUNTIME_login_manager ?= "busybox"
VIRTUAL-RUNTIME_init_manager ?= "busybox"


# Don't include kernels in standard images
RDEPENDS_kernel-base = ""

KERNEL_IMAGETYPE = "uImage"

  
  
DEFAULTTUNE = "armv6"

# used by sysvinit_2
SERIAL_CONSOLE ?= "38400 ttyS0"

ROOT_FLASH_SIZE = "256"
IMAGE_FSTYPES += "squashfs jffs2"


# NAND
MKUBIFS_ARGS = " -e 0x1f000 -c 2048 -m 0x800  -x lzo"
UBINIZE_ARGS = " -m 0x800 -p 0x20000 -s 2048"

JFFS2_ERASEBLOCK="128KiB"

UBI_VOLNAME = "rootfs"

UBOOT_MACHINE = "cavium_cns3000_config"
#UBOOT_ENTRYPOINT = "0x20008000"
#UBOOT_LOADADDRESS = "0x20008000"
#cavium/econa/xo1+5 uboot has 3 deficiencies
#	1) loading at 0x8000 is not ok its using it.
#	2) XIP for linux kernel is not functional
#	3) RELOC KERNEL from alias to real region causes issues
#	this means entrypoint at 2000000 is a good choice
#	and bootm argument should be 22000000
#	this also means that kernel uncompressed images are a no go.
UBOOT_ENTRYPOINT = "0x2000000"
UBOOT_LOADADDRESS = "0x2000000"
```
